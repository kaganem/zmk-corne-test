## config/west.yml
```yaml
manifest:
  remotes:
    - name: kaganem
      url-base: https://github.com/kaganem
  projects:
    - name: zmk
      remote: kaganem
      revision: main
      import: app/west.yml
  self:
    path: config
```
